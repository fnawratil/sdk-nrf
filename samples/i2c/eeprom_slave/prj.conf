## prj.conf
```kconfig
#
# Copyright (c) 2019 Nordic Semiconductor ASA
#
# SPDX-License-Identifier: LicenseRef-Nordic-5-Clause
#
# General config
CONFIG_HEAP_MEM_POOL_SIZE=4096
CONFIG_NEWLIB_LIBC=y

# Main thread
CONFIG_MAIN_STACK_SIZE=4096

CONFIG_I2C=y
CONFIG_I2C_VIRTUAL_EEPROM_DRIVER=y
CONFIG_I2C_VIRTUAL_EEPROM_DRIVER_LOG_LEVEL_DBG=y

CONFIG_LOG=y
CONFIG_LOG_BACKEND_UART=y
CONFIG_LOG_BUFFER_SIZE=4096
```

## boards/nrf5340dk_nrf5340_cpuapp_ns.overlay
```dts
/*
 * Copyright (c) 2023 Nordic Semiconductor ASA
 *
 * SPDX-License-Identifier: Apache-2.0
 */

&i2c1 {
	compatible = "nordic,nrf-twis";
	status = "okay";
};

/ {
	eeprom {
		compatible = "nordic,i2c-virtual-eeprom";
		status = "okay";
		i2c-bus-idx = <1>;
		sda-gpios = <&gpio1 2 GPIO_ACTIVE_HIGH>;
		scl-gpios = <&gpio1 3 GPIO_ACTIVE_HIGH>;
		address = <0x7>;
	};
};
```

## src/main.c
```c
/*
 * Copyright (c) 2019 Nordic Semiconductor ASA
 *
 * SPDX-License-Identifier: LicenseRef-Nordic-5-Clause
 */

#include <stdio.h>
#include <string.h>

#include <zephyr/kernel.h>



int main(void)
{
	printk("The sample started\n");
	return 0;
}
```
